## applications/linux-workloads/configs/buildroot-p2e.defconfig
```kconfig
BR2_riscv=y
BR2_TOOLCHAIN_EXTERNAL=y
BR2_TOOLCHAIN_EXTERNAL_CUSTOM=y
BR2_TOOLCHAIN_EXTERNAL_PATH="$(RISCV)"
BR2_TOOLCHAIN_EXTERNAL_CUSTOM_PREFIX="$(ARCH)-unknown-linux-gnu"
BR2_TOOLCHAIN_EXTERNAL_HEADERS_6_8=y
BR2_TOOLCHAIN_EXTERNAL_CUSTOM_GLIBC=y
# BR2_TOOLCHAIN_EXTERNAL_INET_RPC is not set
BR2_TOOLCHAIN_EXTERNAL_CXX=y
BR2_TOOLCHAIN_EXTERNAL_OPENMP=y
BR2_WGET="wget --passive-ftp -nd -t 3"
BR2_PRIMARY_SITE="https://mirror.nju.edu.cn/buildroot"
BR2_BACKUP_SITE="http://sources.buildroot.net"
BR2_JLEVEL=16
BR2_OPTIMIZE_S=y
BR2_SSP_NONE=y
BR2_FORTIFY_SOURCE_NONE=y
BR2_ROOTFS_MERGED_USR=y
BR2_SYSTEM_DEFAULT_PATH="/bin:/sbin:/usr/bin:/usr/sbin"
BR2_ROOTFS_POST_BUILD_SCRIPT="../../scripts/fix-linux-nix-elfs.sh"
BR2_PACKAGE_BUSYBOX_CONFIG="../firemarshal/wlutil/busybox-config"
# BR2_PACKAGE_IFUPDOWN_SCRIPTS is not set
# BR2_PACKAGE_URANDOM_SCRIPTS is not set
BR2_LINUX_KERNEL=y
BR2_LINUX_KERNEL_CUSTOM_TARBALL=y
BR2_LINUX_KERNEL_CUSTOM_TARBALL_LOCATION="https://github.com/firesim/linux/archive/67bc4513761f09952a5d5f5c899630ed91ce6442.tar.gz"
BR2_LINUX_KERNEL_USE_CUSTOM_CONFIG=y
BR2_LINUX_KERNEL_CUSTOM_CONFIG_FILE="../firemarshal/../configs/linux-base.config"
BR2_LINUX_KERNEL_IMAGE=y
BR2_TARGET_OPENSBI=y
BR2_TARGET_OPENSBI_CUSTOM_GIT=y
BR2_TARGET_OPENSBI_CUSTOM_REPO_URL="https://github.com/riscv-software-src/opensbi.git"
BR2_TARGET_OPENSBI_CUSTOM_REPO_VERSION="5ccebf0a7ec79d0bbef36d6dcdc2717f25d40767"
BR2_TARGET_OPENSBI_PLAT="generic"
BR2_TARGET_ROOTFS_CPIO=y
BR2_TARGET_ROOTFS_EXT2=y
BR2_TARGET_ROOTFS_EXT2_LABEL=""
BR2_TARGET_ROOTFS_EXT2_SIZE="512M"
# BR2_TARGET_ROOTFS_TAR is not set
BR2_PACKAGE_HOST_MKPASSWD=y
```
